## conf/layer.conf
```bitbake
# We have a conf and classes directory, add to BBPATH
BBPATH .= ":${LAYERDIR}"

# We have recipes-* directories, add to BBFILES
BBFILES += "${LAYERDIR}/recipes-*/*/*.bb \
            ${LAYERDIR}/recipes-*/*/*.bbappend"

BBFILE_COLLECTIONS += "meta-sys-monitor"
BBFILE_PATTERN_meta-sys-monitor = "^${LAYERDIR}/"
BBFILE_PRIORITY_meta-sys-monitor = "6"

LAYERDEPENDS_meta-sys-monitor = "core"
LAYERSERIES_COMPAT_meta-sys-monitor = "dunfell"
```
